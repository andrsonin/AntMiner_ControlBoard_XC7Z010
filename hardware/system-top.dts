/*
 * CAUTION: This file is automatically generated by Xilinx.
 * Version: XSCT 2019.1
 * Today is: Thu Jul 17 16:31:11 2025
 */


/dts-v1/;
/include/ "zynq-7000.dtsi"
/include/ "pl.dtsi"
/include/ "pcw.dtsi"
/ {
	chosen {
		bootargs = "earlycon";
		stdout-path = "serial0:110n8";
	};
	aliases {
		ethernet0 = &gem0;
		i2c0 = &i2c0;
		i2c1 = &i2c1;
		serial0 = &axi_uartlite_0;
		serial1 = &uart1;
		spi0 = &spi0;
	};
	memory@0 {
		device_type = "memory";
		reg = <0x0 0x40000000>;
	};
};
